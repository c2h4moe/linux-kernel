## drivers/cxl/pool/Kconfig
```kconfig
config CXL_POOL
	tristate "CXL Memory Pool Allocator"
	depends on CXL_MEM && DAX
	help
	  CXL memory pool allocator with free list management.
	  This module provides a simple allocator for CXL memory that can
	  be shared by user-space runtimes. The module initializes the pool
	  metadata on first load and reuses it on later loads.
```
